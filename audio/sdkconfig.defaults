## audio/sdkconfig.defaults
```kconfig
CONFIG_AUTOSTART_ARDUINO=y
CONFIG_ESPTOOLPY_FLASHSIZE_4MB=y
# CONFIG_ESPTOOLPY_FLASHSIZE_2MB is not set
CONFIG_ESPTOOLPY_FLASHSIZE="4MB"
CONFIG_FREERTOS_HZ=1000
CONFIG_ARDUINO_LOOP_STACK_SIZE=8192
CONFIG_ARDUINO_RUNNING_CORE=1
CONFIG_ARDUINO_EVENT_RUNNING_CORE=0
CONFIG_BT_ENABLED=y
CONFIG_BT_BLUEDROID_ENABLED=y
CONFIG_BTDM_CTRL_MODE_BR_EDR_ONLY=y
# CONFIG_BTDM_CTRL_MODE_BTDM is not set
# CONFIG_BTDM_CTRL_MODE_BLE_ONLY is not set
CONFIG_BT_CLASSIC_ENABLED=y
# CONFIG_BT_BLE_ENABLED is not set
CONFIG_BT_A2DP_ENABLE=y
CONFIG_BT_AVRC_ENABLED=y
CONFIG_BT_SSP_ENABLED=y
# CONFIG_BT_SPP_ENABLED is not set
# CONFIG_BT_HFP_ENABLE is not set
CONFIG_BTDM_CTRL_BR_EDR_MAX_ACL_CONN=1
CONFIG_BTDM_CTRL_BR_EDR_MAX_SYNC_CONN=0
CONFIG_MBEDTLS_ASYMMETRIC_CONTENT_LEN=y
CONFIG_MBEDTLS_SSL_IN_CONTENT_LEN=16384
CONFIG_MBEDTLS_SSL_OUT_CONTENT_LEN=4096
CONFIG_MBEDTLS_CERTIFICATE_BUNDLE=y
CONFIG_MBEDTLS_PSK_MODES=y
CONFIG_MBEDTLS_KEY_EXCHANGE_PSK=y
CONFIG_COMPILER_OPTIMIZATION_SIZE=y
CONFIG_ESP32_DEFAULT_CPU_FREQ_240=y
CONFIG_LOG_DEFAULT_LEVEL_ERROR=y
```
